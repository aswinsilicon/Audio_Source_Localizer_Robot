// Unchanged global arrays and definitions
static const double hreal[ 256 ] = {
0.0008417114875644768, -0.1519474796571758, 0.6387883033901737, -0.9673246288361885, 1.002941881018574, -0.9994297893033115, 0.9990347245225664, -0.9979636003928459, 0.9969366734449696, -0.9954655177766091, 0.9943311317107739, -0.9923523123466036,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 -0.1519474796571758
};

static const double himag[ 256 ] = {
0.0, -0.0018647697277626258, 0.015681372667527, -0.035628675810066346, 0.04927137511630637, -0.06140132091618618, 0.07369322852559383, -0.08593948694847894, 0.09818969202581802, -0.11039504698717018, 0.12263904792105407, -0.13477759823157165,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 0.0018647697277626141     
};

#include <driver/i2s.h>
#include <arduinoFFT.h>
#include <stdint.h>
#include <math.h> 
#include <string.h>

#define I2S_WS 15
#define I2S_SD 13
#define I2S_SCK 2
#define I2S_PORT I2S_NUM_0
#define sample_no 256
#define STEREO_SAMPLES_COUNT 512
#define sample_index_last 127
#define sampling_rate 44100

double res_real_L[sample_no];
double res_img_L[sample_no];
double res_real_R[sample_no];
double res_img_R[sample_no];
double G_real[sample_no];
double G_img[sample_no];
double phat_real[sample_no];
double phat_img[sample_no];

// i2s Functions
void i2s_install(){
  static const i2s_config_t i2s_config = {
    .mode = i2s_mode_t(I2S_MODE_MASTER | I2S_MODE_RX),
    .sample_rate = sampling_rate,
    .bits_per_sample = i2s_bits_per_sample_t(24),
    .channel_format = I2S_CHANNEL_FMT_RIGHT_LEFT,
    .communication_format = i2s_comm_format_t(I2S_COMM_FORMAT_I2S| I2S_COMM_FORMAT_I2S_MSB),
    .intr_alloc_flags = 0, // default interrupt priority
    .dma_buf_count = 8,
    .dma_buf_len = 64,
    .use_apll = false
  };

  i2s_driver_install(I2S_PORT, &i2s_config, 0, NULL);
}

void i2s_setpin(){
  static const i2s_pin_config_t pin_config = {
    .bck_io_num = I2S_SCK,
    .ws_io_num = I2S_WS,
    .data_out_num = -1,
    .data_in_num = I2S_SD
  };

  i2s_set_pin(I2S_PORT, &pin_config);
}

//FFT functions
void FFT(double *xreal,double *ximag){
  ArduinoFFT<double> FFT = ArduinoFFT<double>(xreal, ximag, sample_no, sampling_rate);
  FFT.windowing(FFTWindow::Hamming, FFTDirection::Forward); /* Weigh data */
  FFT.compute(FFTDirection::Forward); /* Compute FFT */
}
void IFFT(double *xreal,double *ximag){
  ArduinoFFT<double> FFT = ArduinoFFT<double>(xreal, ximag, sample_no, sampling_rate);
  FFT.compute(FFTDirection::Reverse);
}


// FIR Filter functions

void complex_array_multiply( double *v1Real,  double *v1Img,const double *v2Real, const double *v2Img,double *r1Real, double *r1Img)
{
    for (uint16_t i = 0; i < sample_no; i++) {
        r1Real[i] = v1Real[i] * v2Real[i] - v1Img[i] * v2Img[i];
        r1Img[i]  = v1Real[i] * v2Img[i] + v1Img[i] * v2Real[i];
    }
}


void FIR_filter(uint8_t l_r,int32_t *sample_buffer, double *res_real, double *res_img)
{
    static double xreal[sample_no];
    static double xImag[sample_no];

   
    memset(xImag, 0, sizeof(xImag));
    for (uint16_t i = 0; i < sample_no; i++) {
        xreal[i] = (double)(sample_buffer[i * 2 + l_r]>>8);
    }
    FFT(xreal,xImag);
    complex_array_multiply( xreal, xImag, hreal , himag, res_real,res_img);
}

double  max_array(double arr[], int n) {
    int idx = 0;
    double max= arr[0];
    for (int i = 1; i < n; i++) {
        if (arr[i] > max) {
            idx = i;
            max=arr[idx];
        }
    }
    return idx;
}
double dominant_frequency(double *xreal, double *ximag, int N, double fs) {
    int i, maxIndex = 0;
    double mag, maxMag = 0.0;
    double freqResolution = fs / N;

    for (i = 0; i < N/2; i++) { // only first half is unique
        mag = sqrt(xreal[i]*xreal[i] + ximag[i]*ximag[i]);
        if (mag > maxMag) {
            maxMag = mag;
            maxIndex = i;
        }
    }
    return maxIndex * freqResolution;
}


// GCC-PHAT functions

void cross_power_spectrum(const double *xReal, const double *xImag, const double *yReal, const double *yImag, double *gReal, double *gImag, int n) {
  for (int i = 0; i < n; i++) {
    // G = (xReal + j*xImag) * (yReal - j*yImag)
    // G = (xReal*yReal + xImag*yImag) + j*(xImag*yReal - xReal*yImag)
    gReal[i] = xReal[i] * yReal[i] + xImag[i] * yImag[i];
    gImag[i] = xImag[i] * yReal[i] - xReal[i] * yImag[i];
  }
}


double gcc_phat(const double *gReal, const double *gImag, double *phat_real, double *phat_img, int n)
{
  for (int i = 0; i < n; i++)
  {
    // Calculate magnitude: |G| = sqrt(G_real^2 + G_imag^2)
    double magnitude = sqrt(gReal[i] * gReal[i] + gImag[i] * gImag[i]);

    // Normalize: G_phat = G / |G| to prevent division by zero
    if (magnitude > 1e-22) { // Use a small epsilon for float comparison
      phat_real[i] = gReal[i] / magnitude;
      phat_img[i]  = gImag[i] / magnitude;
    } else {
      phat_real[i] = 0.0;
      phat_img[i]  = 0.0;
    }
  }
  IFFT(phat_real, phat_img);
  double maximum = max_array(phat_real, n);
  if (maximum <= n/2) return maximum;
  else return maximum-n;
}

void setup() {
  Serial.begin(115200);
  i2s_install();
  i2s_setpin();
  i2s_start(I2S_PORT);
  delay(500);
}

void loop() {

  static int32_t sample_buffer[STEREO_SAMPLES_COUNT];
  size_t bytes = 0;
  esp_err_t result = i2s_read(I2S_PORT, &sample_buffer, sizeof(sample_buffer), &bytes, 100);

  if (result == ESP_OK && bytes == sizeof(sample_buffer))
  {
    // Perform filtering and FFT on both channels
    FIR_filter(0, sample_buffer, res_real_L, res_img_L);
    FIR_filter(1, sample_buffer, res_real_R, res_img_R);

    double dominant_frqL=dominant_frequency(res_real_L, res_img_L, sample_no, sampling_rate);
    double dominant_frqR=dominant_frequency(res_real_R, res_img_R,  sample_no, sampling_rate);


    // --- Start of GCC-PHAT Calculation ---

    // Calculate the cross-power spectrum: G = FFT(L) * conj(FFT(R))
    cross_power_spectrum(res_real_L, res_img_L, res_real_R, res_img_R, G_real, G_img, sample_no);



    // Calculate GCC-PHAT and find the peak
    double tdoa = ((double)gcc_phat(G_real, G_img, phat_real, phat_img, sample_no))/sampling_rate;
    

  }
}